## boards/shields/acorn/Kconfig.defconfig
```kconfig
if SHIELD_ACCORNE_CENTRAL_LT || SHIELD_ACCORNE_CENTRAL_DONGLE

config ZMK_SPLIT_ROLE_CENTRAL
    default y

endif

#if SHIELD_ACCORNE_CENTRAL_DONGLE
#
#config ZMK_KEYBOARD_NAME
#    default "accorne.dongle"
#
#endif

if SHIELD_ACCORNE_CENTRAL_LT

config ZMK_KEYBOARD_NAME
    default "accorne.central"

endif

#if SHIELD_ACCORNE_PERI_LT
#
#config ZMK_KEYBOARD_NAME
#    default "accorne.lt"
#
#endif

if SHIELD_ACCORNE_PERI_RT

config ZMK_KEYBOARD_NAME
    default "accorne.rt"

endif

if SHIELD_ACCORNE_CENTRAL_DONGLE || SHIELD_ACCORNE_CENTRAL_LT || SHIELD_ACCORNE_PERI_LT || SHIELD_ACCORNE_PERI_RT

config ZMK_SPLIT
    default y

config I2C
    default y

if ZMK_DISPLAY

config SSD1306
    default y

choice LV_FONT_DEFAULT
    default LV_FONT_DEFAULT_MONTSERRAT_12
endchoice

choice ZMK_LV_FONT_DEFAULT_SMALL
    default ZMK_LV_FONT_DEFAULT_SMALL_MONTSERRAT_12
endchoice

config LV_Z_VDB_SIZE
    default 64

config LV_DPI_DEF
    default 148

config LV_Z_BITS_PER_PIXEL
    default 1

choice LV_COLOR_DEPTH
    default LV_COLOR_DEPTH_1
endchoice

endif # ZMK_DISPLAY

endif
```

## boards/shields/acorn/Kconfig.shield
```kconfig
# No whitespace after the comma or in part name!
config ACCORNE_CENTRAL_DONGLE
    def_bool $(shields_list_contains,accorne_central_dongle)

config ACCORNE_CENTRAL_LEFT
    def_bool $(shields_list_contains,accorne_central_lt)

#config ACCORNE_CENTRAL_RIGHT
#    def_bool $(shields_list_contains,accorne_central_rt)

config ACCORNE_PERIPHERAL_LEFT
    def_bool $(shields_list_contains,accorne_peri_lt)

config ACCORNE_PERIPHERAL_RIGHT
    def_bool $(shields_list_contains,accorne_peri_rt)
```
